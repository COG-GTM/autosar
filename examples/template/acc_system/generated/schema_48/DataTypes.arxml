AUTOSAR XML (schema 00048)
package /DataTypes/Units
  6 x unit:
    Meter: display-name=m
    MeterPerSecond: display-name=m/s
    KmPerHour: display-name=km/h
    Second: display-name=s
    NewtonMeter: display-name=Nm
    MeterPerSecondSquared: display-name=m/s^2
package /DataTypes/CompuMethods
  compu method TargetDistance_T_CompuMethod: phys=raw*0.05 for raw 0..5000; unit m  # Distance to target, resolution 0.05 m
  compu method RelativeSpeed_T_CompuMethod: phys=raw*0.01 for raw -12800..12800; unit m/s  # Relative speed, resolution 0.01 m/s
  compu method VehicleSpeed_T_CompuMethod: phys=raw/64 for raw 0..65535; unit km/h  # Vehicle speed, resolution 1/64 km/h
  compu method SetSpeed_T_CompuMethod: phys=raw for raw 0..255; unit km/h  # Driver selected speed, resolution 1 km/h
  compu method TimeGap_T_CompuMethod: phys=raw*0.1 for raw 8..25; unit s  # Headway time gap, resolution 0.1 s
  compu method TorqueRequest_T_CompuMethod: phys=raw*0.5 for raw -2000..2000; unit Nm  # Torque request, resolution 0.5 Nm
  compu method LongitudinalAccel_T_CompuMethod: phys=raw*0.001 for raw -10000..5000; unit m/s^2  # Acceleration, resolution 0.001 m/s^2
package /DataTypes/ApplicationDataTypes
  9 x app type, all with category=VALUE:
    TargetDistance_T: compu-method=TargetDistance_T_CompuMethod, range phys 0..250 m, unit=m  # Longitudinal distance to the tracked target
    RelativeSpeed_T: compu-method=RelativeSpeed_T_CompuMethod, range phys -128..128 m/s, unit=m/s  # Target speed relative to ego vehicle
    RadarTargetValid_T: compu {0=RadarTargetValid_NotValid, 1=RadarTargetValid_Valid}, range raw 0..1  # Plausibility status of the radar target
    VehicleSpeed_T: compu-method=VehicleSpeed_T_CompuMethod, range phys 0..1023.984375 km/h, unit=km/h  # Vehicle longitudinal speed
    SetSpeed_T: compu-method=SetSpeed_T_CompuMethod, range phys 0..255 km/h, unit=km/h  # Driver selected cruise speed
    TimeGap_T: compu-method=TimeGap_T_CompuMethod, range phys 0.8..2.5 s, unit=s  # Driver selected headway time gap
    TorqueRequest_T: compu-method=TorqueRequest_T_CompuMethod, range phys -1000..1000 Nm, unit=Nm  # Requested engine torque at the crankshaft
    LongitudinalAccel_T: compu-method=LongitudinalAccel_T_CompuMethod, range phys -10..5 m/s^2, unit=m/s^2  # Longitudinal acceleration request or measurement
    AccMode_T: compu {0=AccMode_Off, 1=AccMode_Standby, 2=AccMode_Active, 3=AccMode_Override}, range raw 0..3  # Operating mode of the ACC function
package /DataTypes/ImplementationDataTypes
  9 x impl type, all with category=VALUE:
    VehicleSpeed_T: base-type=uint16, compu-method=VehicleSpeed_T_CompuMethod, range raw 0..65535
    SetSpeed_T: base-type=uint8, compu-method=SetSpeed_T_CompuMethod, range raw 0..255
    TargetDistance_T: base-type=uint16, compu-method=TargetDistance_T_CompuMethod, range raw 0..5000
    RelativeSpeed_T: base-type=sint16, compu-method=RelativeSpeed_T_CompuMethod, range raw -12800..12800
    LongitudinalAccel_T: base-type=sint16, compu-method=LongitudinalAccel_T_CompuMethod, range raw -10000..5000
    TorqueRequest_T: base-type=sint16, compu-method=TorqueRequest_T_CompuMethod, range raw -2000..2000
    TimeGap_T: base-type=uint8, compu-method=TimeGap_T_CompuMethod, range raw 8..25
    RadarTargetValid_T: base-type=uint8, compu {0=RadarTargetValid_NotValid, 1=RadarTargetValid_Valid}, range raw 0..1
    AccMode_T: base-type=uint8, compu {0=AccMode_Off, 1=AccMode_Standby, 2=AccMode_Active, 3=AccMode_Override}, range raw 0..3
package /DataTypes/DataTypeMappingSets
  data type mapping set AccTypeMappingSet
    data-type-maps:
      application-data-type=VehicleSpeed_T, implementation-data-type=VehicleSpeed_T
      application-data-type=SetSpeed_T, implementation-data-type=SetSpeed_T
      application-data-type=TargetDistance_T, implementation-data-type=TargetDistance_T
      application-data-type=RelativeSpeed_T, implementation-data-type=RelativeSpeed_T
      application-data-type=LongitudinalAccel_T, implementation-data-type=LongitudinalAccel_T
      application-data-type=TorqueRequest_T, implementation-data-type=TorqueRequest_T
      application-data-type=TimeGap_T, implementation-data-type=TimeGap_T
      application-data-type=RadarTargetValid_T, implementation-data-type=RadarTargetValid_T
      application-data-type=AccMode_T, implementation-data-type=AccMode_T
