AUTOSAR XML (schema 00048)
standard types defined: boolean, uint8, uint16, uint32, sint16, boolean_DataConstr, uint8_DataConstr, uint16_DataConstr, uint32_DataConstr, boolean_CompuMethod
