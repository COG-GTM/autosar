AUTOSAR XML (schema 00049)
package /ModeDclrGroups
  mode declaration group AccMode: initial-mode=OFF
    4 x mode:
      OFF
      STANDBY
      ACTIVE
      OVERRIDE
package /PortInterfaces
  5 x sender receiver interface:
    RadarRawTarget_I
      data RawDistance: type=TargetDistance_T
      data RawRelativeSpeed: type=RelativeSpeed_T
      data RawTargetValid: type=RadarTargetValid_T
    VehicleSpeed_I
      data VehicleSpeed: type=VehicleSpeed_T
    AccDriverRequest_I
      data SetSpeed: type=SetSpeed_T
      data TimeGap: type=TimeGap_T
    EngineTorqueRequest_I
      data TorqueRequest: type=TorqueRequest_T
    BrakeDecelRequest_I
      data DecelRequest: type=LongitudinalAccel_T
  client server interface AccCalibration_I: is-service=true
    operation ReadParameter: possible-error=[E_NOT_OK, E_OUT_OF_RANGE]
      arg parameterId: type=uint8, direction=IN
      arg parameterValue: type=uint16, direction=OUT
    operation WriteParameter: possible-error=[E_NOT_OK, E_OUT_OF_RANGE]
      arg parameterId: type=uint8, direction=IN
      arg parameterValue: type=uint16, direction=IN
    error E_NOT_OK: error-code=1
    error E_OUT_OF_RANGE: error-code=2
  mode switch interface AccMode_I
    mode group accMode: type=AccMode
  sender receiver interface RadarTarget_I
    data TargetDistance: type=TargetDistance_T
    data TargetRelativeSpeed: type=RelativeSpeed_T
    data TargetValid: type=RadarTargetValid_T
  sender receiver interface AccAccelRequest_I
    data AccelRequest: type=LongitudinalAccel_T
