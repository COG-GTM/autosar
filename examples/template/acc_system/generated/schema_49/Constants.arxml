AUTOSAR XML (schema 00049)
package /Constants
  8 x constant specification:
    TargetDistance_IV: value-spec=250 Meter
    RelativeSpeed_IV: value-spec=0 MeterPerSecond
    RadarTargetValid_IV: value-spec=RadarTargetValid_NotValid
    VehicleSpeed_IV: value-spec=0 KmPerHour
    SetSpeed_IV: value-spec=0 KmPerHour
    TimeGap_IV: value-spec=1.5 Second
    LongitudinalAccel_IV: value-spec=0 MeterPerSecondSquared
    TorqueRequest_IV: value-spec=0 NewtonMeter
