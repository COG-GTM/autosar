AUTOSAR XML (schema 00051)
package /ModeDclrGroups
  mode declaration group EcuM_Mode: initial-mode=STARTUP
    6 x mode:
      STARTUP
      RUN
      POST_RUN
      SLEEP
      WAKEUP
      SHUTDOWN
package /PortInterfaces
  sender receiver interface EngineSpeed_I
    data EngineSpeed: type=uint16
  sender receiver interface VehicleSpeed_I
    data VehicleSpeed: type=uint16
  sender receiver interface WheelSpeed_I
    data WheelSpeed: type=WheelSpeed_T
  mode switch interface EcuM_CurrentMode_I: is-service=true
    mode group currentMode: type=EcuM_Mode
  client server interface FreeRunningTimer_I
    operation GetTime
      arg value: type=uint32, direction=OUT
    operation IsTimerElapsed
      arg startTime: type=uint32, direction=IN
      arg duration: type=uint32, direction=IN
      arg result: type=boolean, direction=OUT
