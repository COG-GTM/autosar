AUTOSAR XML (schema 00051)
package /DataTypes/Units
  unit KmPerHour: display-name=km/h
package /DataTypes/ImplementationDataTypes
  impl type WheelSpeed_T: category=VALUE, base-type=uint16, compu {phys=raw*0.01 for raw 0..65535; unit km/h}, range raw 0..65535
