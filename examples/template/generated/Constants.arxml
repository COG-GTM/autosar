AUTOSAR XML (schema 00051)
package /Constants
  constant specification EngineSpeed_IV: value-spec=65535
  constant specification VehicleSpeed_IV: value-spec=65535
  constant specification WheelSpeed_IV: value-spec=0
