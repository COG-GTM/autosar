AUTOSAR XML (schema 00051)
standard types defined: uint8, uint16
package /AUTOSAR_Platform/DataConstraints
  range WindowPosition_DataConstr: raw 0..100
package /AUTOSAR_Platform/CompuMethods
  compu method WindowPosition_CompuMethod: phys=raw for raw 0..100
