AUTOSAR XML (schema 00051)
package /PortInterfaces
  sender receiver interface WindowPosition_I
    data WindowPosition: type=uint8
