AUTOSAR XML (schema 00051)
package /ComponentTypes
  composition sw component type BodyControlModule
    component WindowController: type=WindowController
    component DoorSensor: type=DoorSensor
    connect WindowController.WindowPositionPort -> DoorSensor.WindowPositionPort
