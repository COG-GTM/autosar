AUTOSAR XML (schema 00051)
package /Constants
  constant specification WindowPosition_IV: value-spec=0
